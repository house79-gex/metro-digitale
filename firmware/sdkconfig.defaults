## firmware/sdkconfig.defaults
```kconfig
# Configurazione di default per Metro Digitale ESP32-S3 v2.0

# Target ESP32-S3
CONFIG_IDF_TARGET="esp32s3"
CONFIG_IDF_TARGET_ESP32S3=y

# Flash e PSRAM (aggiornato per 16MB flash)
CONFIG_ESPTOOLPY_FLASHSIZE_16MB=y
CONFIG_PARTITION_TABLE_CUSTOM=y
CONFIG_PARTITION_TABLE_CUSTOM_FILENAME="partitions.csv"

# PSRAM (ESSENZIALE per framebuffer LVGL)
CONFIG_ESP32S3_SPIRAM_SUPPORT=y
CONFIG_SPIRAM=y
CONFIG_SPIRAM_MODE_OCT=y
CONFIG_SPIRAM_SPEED_80M=y
CONFIG_SPIRAM_BOOT_INIT=y
CONFIG_SPIRAM_USE_MALLOC=y
CONFIG_SPIRAM_MALLOC_ALWAYSINTERNAL=16384
CONFIG_SPIRAM_MALLOC_RESERVE_INTERNAL=32768

# Bluetooth BLE 5.0
CONFIG_BT_ENABLED=y
CONFIG_BTDM_CTRL_MODE_BLE_ONLY=y
CONFIG_BTDM_CTRL_MODE_BR_EDR_ONLY=n
CONFIG_BTDM_CTRL_MODE_BTDM=n
CONFIG_BT_BLUEDROID_ENABLED=y
CONFIG_BT_BLE_ENABLED=y
CONFIG_BT_BLE_42_FEATURES_SUPPORTED=y
CONFIG_BT_BLE_50_FEATURES_SUPPORTED=y
CONFIG_BT_GATTS_ENABLE=y
CONFIG_BT_GATT_MAX_SR_ATTRIBUTES=30

# LVGL Display Configuration (800x480)
CONFIG_LV_MEM_CUSTOM=y
CONFIG_LV_MEMCPY_MEMSET_STD=y
CONFIG_LV_COLOR_DEPTH_16=y
CONFIG_LV_COLOR_16_SWAP=n
CONFIG_LV_DISP_DEF_REFR_PERIOD=30
CONFIG_LV_DPI_DEF=100

# FreeRTOS
CONFIG_FREERTOS_HZ=1000
CONFIG_FREERTOS_UNICORE=n
CONFIG_FREERTOS_WATCHPOINT_END_OF_STACK=y

# Logging
CONFIG_LOG_DEFAULT_LEVEL_INFO=y
CONFIG_LOG_COLORS=y

# NVS
CONFIG_NVS_ENCRYPTION=n

# FAT Filesystem (SD Card)
CONFIG_FATFS_LFN_HEAP=y
CONFIG_FATFS_MAX_LFN=255
CONFIG_FATFS_USE_FASTSEEK=y

# SPI
CONFIG_SPI_MASTER_ISR_IN_IRAM=y

# I2C
CONFIG_I2C_ENABLE_DEBUG_LOG=n

# PCNT (Pulse Counter)
CONFIG_PCNT_ENABLE_DEBUG_LOG=n

# GPIO
CONFIG_GPIO_ESP32_SUPPORT_SWITCH_SLP_PULL=y

# LEDC (PWM for buzzer and backlight)
CONFIG_LEDC_ENABLE_DEBUG_LOG=n

# USB OTG (per pendrive)
CONFIG_USB_OTG_SUPPORTED=y
CONFIG_USB_HOST_CONTROL_TRANSFER_MAX_SIZE=256

# Performance
CONFIG_COMPILER_OPTIMIZATION_PERF=y
CONFIG_ESP32S3_DEFAULT_CPU_FREQ_240=y

# Task watchdog
CONFIG_ESP_TASK_WDT=y
CONFIG_ESP_TASK_WDT_TIMEOUT_S=10

# Main task stack size (aumentato per LVGL)
CONFIG_ESP_MAIN_TASK_STACK_SIZE=8192

# System
CONFIG_ESP_SYSTEM_EVENT_TASK_STACK_SIZE=4096
```
